## drivers/interconnect/tegra/Kconfig
```kconfig
# SPDX-License-Identifier: GPL-2.0-only
config INTERCONNECT_TEGRA
	bool "NVIDIA Tegra interconnect drivers"
	depends on ARCH_TEGRA || COMPILE_TEST
	help
	  Say Y here to enable support for NVIDIA Tegra interconnect drivers.
```
