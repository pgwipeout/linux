/ {
	 memory-controller@7000f000 {
		emc-timings-0 {
			nvidia,ram-code = <0>;
/*			timing-2550000 {
				clock-frequency = <2550000>;

				nvidia,emc-zcal-cnt-long = <0x00000040>;
				nvidia,emc-auto-cal-interval = <0x001fffff>;
				nvidia,emc-mode-reset = <0x80001221>;
				nvidia,emc-mode-1 = <0x80100003>;
				nvidia,emc-mode-2 = <0x80200008>;
			
				nvidia,emem-configuration = <
					0x00000001 /* EMC_RC */
					0x00000006 /* EMC_RFC */
					0x00000000 /* EMC_RAS */
					0x00000000 /* EMC_RP */
					0x00000002 /* EMC_R2W */
					0x0000000a /* EMC_W2R */
					0x00000005 /* EMC_R2P */
					0x0000000b /* EMC_W2P */
					0x00000000 /* EMC_RD_RCD */
					0x00000000 /* EMC_WR_RCD */
					0x00000003 /* EMC_RRD */
					0x00000001 /* EMC_REXT */
					0x00000000 /* EMC_WEXT */
					0x00000005 /* EMC_WDV */
					0x00000005 /* EMC_QUSE */
					0x00000004 /* EMC_QRST */
					0x0000000a /* EMC_QSAFE */
					0x0000000b /* EMC_RDV */
					0x000000c0 /* EMC_REFRESH */
					0x00000000 /* EMC_BURST_REFRESH_NUM */
					0x00000030 /* EMC_PRE_REFRESH_REQ_CNT */
					0x00000002 /* EMC_PDEX2WR */
					0x00000002 /* EMC_PDEX2RD */
					0x00000001 /* EMC_PCHG2PDEN */
					0x00000000 /* EMC_ACT2PDEN */
					0x00000007 /* EMC_AR2PDEN */
					0x0000000f /* EMC_RW2PDEN */
					0x00000007 /* EMC_TXSR */
					0x00000007 /* EMC_TXSRDLL */
					0x00000004 /* EMC_TCKE */
					0x00000002 /* EMC_TFAW */
					0x00000000 /* EMC_TRPAB */
					0x00000004 /* EMC_TCLKSTABLE */
					0x00000005 /* EMC_TCLKSTOP */
					0x000000c7 /* EMC_TREFBW */
					0x00000006 /* EMC_QUSE_EXTRA */
					0x00000004 /* EMC_FBIO_CFG6 */
					0x00000000 /* EMC_ODT_WRITE */
					0x00000000 /* EMC_ODT_READ */
					0x00004288 /* EMC_FBIO_CFG5 */
					0x007800a4 /* EMC_CFG_DIG_DLL */
					0x00008000 /* EMC_CFG_DIG_DLL_PERIOD */
					0x000fc000 /* EMC_DLL_XFORM_DQS0 */
					0x000fc000 /* EMC_DLL_XFORM_DQS1 */
					0x000fc000 /* EMC_DLL_XFORM_DQS2 */
					0x000fc000 /* EMC_DLL_XFORM_DQS3 */
					0x000fc000 /* EMC_DLL_XFORM_DQS4 */
					0x000fc000 /* EMC_DLL_XFORM_DQS5 */
					0x000fc000 /* EMC_DLL_XFORM_DQS6 */
					0x000fc000 /* EMC_DLL_XFORM_DQS7 */
					0x00000000 /* EMC_DLL_XFORM_QUSE0 */
					0x00000000 /* EMC_DLL_XFORM_QUSE1 */
					0x00000000 /* EMC_DLL_XFORM_QUSE2 */
					0x00000000 /* EMC_DLL_XFORM_QUSE3 */
					0x00000000 /* EMC_DLL_XFORM_QUSE4 */
					0x00000000 /* EMC_DLL_XFORM_QUSE5 */
					0x00000000 /* EMC_DLL_XFORM_QUSE6 */
					0x00000000 /* EMC_DLL_XFORM_QUSE7 */
					0x00000000 /* EMC_DLI_TRIM_TXDQS0 */
					0x00000000 /* EMC_DLI_TRIM_TXDQS1 */
					0x00000000 /* EMC_DLI_TRIM_TXDQS2 */
					0x00000000 /* EMC_DLI_TRIM_TXDQS3 */
					0x00000000 /* EMC_DLI_TRIM_TXDQS4 */
					0x00000000 /* EMC_DLI_TRIM_TXDQS5 */
					0x00000000 /* EMC_DLI_TRIM_TXDQS6 */
					0x00000000 /* EMC_DLI_TRIM_TXDQS7 */
					0x000fc000 /* EMC_DLL_XFORM_DQ0 */
					0x000fc000 /* EMC_DLL_XFORM_DQ1 */
					0x000fc000 /* EMC_DLL_XFORM_DQ2 */
					0x000fc000 /* EMC_DLL_XFORM_DQ3 */
					0x000002a0 /* EMC_XM2CMDPADCTRL */
					0x0800211c /* EMC_XM2DQSPADCTRL2 */
					0x00000000 /* EMC_XM2DQPADCTRL2 */
					0x77fff884 /* EMC_XM2CLKPADCTRL */
					0x01f1f108 /* EMC_XM2COMPPADCTRL */
					0x05057404 /* EMC_XM2VTTGENPADCTRL */
					0x54000007 /* EMC_XM2VTTGENPADCTRL2 */
					0x08000168 /* EMC_XM2QUSEPADCTRL */
					0x08000000 /* EMC_XM2DQSPADCTRL3 */
					0x00000802 /* EMC_CTT_TERM_CTRL */
					0x00000000 /* EMC_ZCAL_INTERVAL */
					0x00000040 /* EMC_ZCAL_WAIT_CNT */
					0x000c000c /* EMC_MRS_WAIT_CNT */
					0xa0f10000 /* EMC_AUTO_CAL_CONFIG */
					0x00000000 /* EMC_CTT */
					0x00000000 /* EMC_CTT_DURATION */
					0x80000287 /* EMC_DYN_SELF_REF_CONTROL */
					0x00030003 /* MC_EMEM_ARB_CFG */
					0xc0000010 /* MC_EMEM_ARB_OUTSTANDING_REQ */
					0x00000001 /* MC_EMEM_ARB_TIMING_RCD */
					0x00000001 /* MC_EMEM_ARB_TIMING_RP */
					0x00000002 /* MC_EMEM_ARB_TIMING_RC */
					0x00000000 /* MC_EMEM_ARB_TIMING_RAS */
					0x00000001 /* MC_EMEM_ARB_TIMING_FAW */
					0x00000001 /* MC_EMEM_ARB_TIMING_RRD */
					0x00000003 /* MC_EMEM_ARB_TIMING_RAP2PRE */
					0x00000008 /* MC_EMEM_ARB_TIMING_WAP2PRE */
					0x00000002 /* MC_EMEM_ARB_TIMING_R2R */
					0x00000001 /* MC_EMEM_ARB_TIMING_W2W */
					0x00000002 /* MC_EMEM_ARB_TIMING_R2W */
					0x00000006 /* MC_EMEM_ARB_TIMING_W2R */
					0x06020102 /* MC_EMEM_ARB_DA_TURNS */
					0x000a0502 /* MC_EMEM_ARB_DA_COVERS */
					0x75830303 /* MC_EMEM_ARB_MISC0 */
					0x001f0000 /* MC_EMEM_ARB_RING1_THROTTLE */
					0xe8000000 /* EMC_FBIO_SPARE */
					0xff00ff00 /* EMC_CFG_RSV */
				>;
			};
			timing-5100000 {
				clock-frequency = <5100000>;

				nvidia,emc-zcal-cnt-long = <0x00000040>;
				nvidia,emc-auto-cal-interval = <0x001fffff>;
				nvidia,emc-mode-reset = <0x80001221>;
				nvidia,emc-mode-1 = <0x80100003>;
				nvidia,emc-mode-2 = <0x80200008>;

				nvidia,emem-configuration = <
					0x00000002 /* EMC_RC */
					0x0000000d /* EMC_RFC */
					0x00000001 /* EMC_RAS */
					0x00000000 /* EMC_RP */
					0x00000002 /* EMC_R2W */
					0x0000000a /* EMC_W2R */
					0x00000005 /* EMC_R2P */
					0x0000000b /* EMC_W2P */
					0x00000000 /* EMC_RD_RCD */
					0x00000000 /* EMC_WR_RCD */
					0x00000003 /* EMC_RRD */
					0x00000001 /* EMC_REXT */
					0x00000000 /* EMC_WEXT */
					0x00000005 /* EMC_WDV */
					0x00000005 /* EMC_QUSE */
					0x00000004 /* EMC_QRST */
					0x0000000a /* EMC_QSAFE */
					0x0000000b /* EMC_RDV */
					0x00000181 /* EMC_REFRESH */
					0x00000000 /* EMC_BURST_REFRESH_NUM */
					0x00000060 /* EMC_PRE_REFRESH_REQ_CNT */
					0x00000002 /* EMC_PDEX2WR */
					0x00000002 /* EMC_PDEX2RD */
					0x00000001 /* EMC_PCHG2PDEN */
					0x00000000 /* EMC_ACT2PDEN */
					0x00000007 /* EMC_AR2PDEN */
					0x0000000f /* EMC_RW2PDEN */
					0x0000000e /* EMC_TXSR */
					0x0000000e /* EMC_TXSRDLL */
					0x00000004 /* EMC_TCKE */
					0x00000003 /* EMC_TFAW */
					0x00000000 /* EMC_TRPAB */
					0x00000004 /* EMC_TCLKSTABLE */
					0x00000005 /* EMC_TCLKSTOP */
					0x0000018e /* EMC_TREFBW */
					0x00000006 /* EMC_QUSE_EXTRA */
					0x00000004 /* EMC_FBIO_CFG6 */
					0x00000000 /* EMC_ODT_WRITE */
					0x00000000 /* EMC_ODT_READ */
					0x00004288 /* EMC_FBIO_CFG5 */
					0x007800a4 /* EMC_CFG_DIG_DLL */
					0x00008000 /* EMC_CFG_DIG_DLL_PERIOD */
					0x000fc000 /* EMC_DLL_XFORM_DQS0 */
					0x000fc000 /* EMC_DLL_XFORM_DQS1 */
					0x000fc000 /* EMC_DLL_XFORM_DQS2 */
					0x000fc000 /* EMC_DLL_XFORM_DQS3 */
					0x000fc000 /* EMC_DLL_XFORM_DQS4 */
					0x000fc000 /* EMC_DLL_XFORM_DQS5 */
					0x000fc000 /* EMC_DLL_XFORM_DQS6 */
					0x000fc000 /* EMC_DLL_XFORM_DQS7 */
					0x00000000 /* EMC_DLL_XFORM_QUSE0 */
					0x00000000 /* EMC_DLL_XFORM_QUSE1 */
					0x00000000 /* EMC_DLL_XFORM_QUSE2 */
					0x00000000 /* EMC_DLL_XFORM_QUSE3 */
					0x00000000 /* EMC_DLL_XFORM_QUSE4 */
					0x00000000 /* EMC_DLL_XFORM_QUSE5 */
					0x00000000 /* EMC_DLL_XFORM_QUSE6 */
					0x00000000 /* EMC_DLL_XFORM_QUSE7 */
					0x00000000 /* EMC_DLI_TRIM_TXDQS0 */
					0x00000000 /* EMC_DLI_TRIM_TXDQS1 */
					0x00000000 /* EMC_DLI_TRIM_TXDQS2 */
					0x00000000 /* EMC_DLI_TRIM_TXDQS3 */
					0x00000000 /* EMC_DLI_TRIM_TXDQS4 */
					0x00000000 /* EMC_DLI_TRIM_TXDQS5 */
					0x00000000 /* EMC_DLI_TRIM_TXDQS6 */
					0x00000000 /* EMC_DLI_TRIM_TXDQS7 */
					0x000fc000 /* EMC_DLL_XFORM_DQ0 */
					0x000fc000 /* EMC_DLL_XFORM_DQ1 */
					0x000fc000 /* EMC_DLL_XFORM_DQ2 */
					0x000fc000 /* EMC_DLL_XFORM_DQ3 */
					0x000002a0 /* EMC_XM2CMDPADCTRL */
					0x0800211c /* EMC_XM2DQSPADCTRL2 */
					0x00000000 /* EMC_XM2DQPADCTRL2 */
					0x77fff884 /* EMC_XM2CLKPADCTRL */
					0x01f1f108 /* EMC_XM2COMPPADCTRL */
					0x05057404 /* EMC_XM2VTTGENPADCTRL */
					0x54000007 /* EMC_XM2VTTGENPADCTRL2 */
					0x08000168 /* EMC_XM2QUSEPADCTRL */
					0x08000000 /* EMC_XM2DQSPADCTRL3 */
					0x00000802 /* EMC_CTT_TERM_CTRL */
					0x00000000 /* EMC_ZCAL_INTERVAL */
					0x00000040 /* EMC_ZCAL_WAIT_CNT */
					0x000c000c /* EMC_MRS_WAIT_CNT */
					0xa0f10000 /* EMC_AUTO_CAL_CONFIG */
					0x00000000 /* EMC_CTT */
					0x00000000 /* EMC_CTT_DURATION */
					0x8000040b /* EMC_DYN_SELF_REF_CONTROL */
					0x00010003 /* MC_EMEM_ARB_CFG */
					0xc0000010 /* MC_EMEM_ARB_OUTSTANDING_REQ */
					0x00000001 /* MC_EMEM_ARB_TIMING_RCD */
					0x00000001 /* MC_EMEM_ARB_TIMING_RP */
					0x00000002 /* MC_EMEM_ARB_TIMING_RC */
					0x00000000 /* MC_EMEM_ARB_TIMING_RAS */
					0x00000001 /* MC_EMEM_ARB_TIMING_FAW */
					0x00000001 /* MC_EMEM_ARB_TIMING_RRD */
					0x00000003 /* MC_EMEM_ARB_TIMING_RAP2PRE */
					0x00000008 /* MC_EMEM_ARB_TIMING_WAP2PRE */
					0x00000002 /* MC_EMEM_ARB_TIMING_R2R */
					0x00000001 /* MC_EMEM_ARB_TIMING_W2W */
					0x00000002 /* MC_EMEM_ARB_TIMING_R2W */
					0x00000006 /* MC_EMEM_ARB_TIMING_W2R */
					0x06020102 /* MC_EMEM_ARB_DA_TURNS */
					0x000a0502 /* MC_EMEM_ARB_DA_COVERS */
					0x74630303 /* MC_EMEM_ARB_MISC0 */
					0x001f0000 /* MC_EMEM_ARB_RING1_THROTTLE */
					0xe8000000 /* EMC_FBIO_SPARE */
					0xff00ff00 /* EMC_CFG_RSV */
				>;
			};
			timing-10200000 {
				clock-frequency = <10200000>;

				nvidia,emc-zcal-cnt-long = <0x00000040>;
				nvidia,emc-auto-cal-interval = <0x001fffff>;
				nvidia,emc-mode-reset = <0x80001221>;
				nvidia,emc-mode-1 = <0x80100003>;
				nvidia,emc-mode-2 = <0x80200008>;

				nvidia,emem-configuration = <
					0x00000004 /* EMC_RC */
					0x0000001a /* EMC_RFC */
					0x00000003 /* EMC_RAS */
					0x00000001 /* EMC_RP */
					0x00000002 /* EMC_R2W */
					0x0000000a /* EMC_W2R */
					0x00000005 /* EMC_R2P */
					0x0000000b /* EMC_W2P */
					0x00000001 /* EMC_RD_RCD */
					0x00000001 /* EMC_WR_RCD */
					0x00000003 /* EMC_RRD */
					0x00000001 /* EMC_REXT */
					0x00000000 /* EMC_WEXT */
					0x00000005 /* EMC_WDV */
					0x00000005 /* EMC_QUSE */
					0x00000004 /* EMC_QRST */
					0x0000000a /* EMC_QSAFE */
					0x0000000b /* EMC_RDV */
					0x00000303 /* EMC_REFRESH */
					0x00000000 /* EMC_BURST_REFRESH_NUM */
					0x000000c0 /* EMC_PRE_REFRESH_REQ_CNT */
					0x00000002 /* EMC_PDEX2WR */
					0x00000002 /* EMC_PDEX2RD */
					0x00000001 /* EMC_PCHG2PDEN */
					0x00000000 /* EMC_ACT2PDEN */
					0x00000007 /* EMC_AR2PDEN */
					0x0000000f /* EMC_RW2PDEN */
					0x0000001c /* EMC_TXSR */
					0x0000001c /* EMC_TXSRDLL */
					0x00000004 /* EMC_TCKE */
					0x00000005 /* EMC_TFAW */
					0x00000000 /* EMC_TRPAB */
					0x00000004 /* EMC_TCLKSTABLE */
					0x00000005 /* EMC_TCLKSTOP */
					0x0000031c /* EMC_TREFBW */
					0x00000006 /* EMC_QUSE_EXTRA */
					0x00000004 /* EMC_FBIO_CFG6 */
					0x00000000 /* EMC_ODT_WRITE */
					0x00000000 /* EMC_ODT_READ */
					0x00004288 /* EMC_FBIO_CFG5 */
					0x007800a4 /* EMC_CFG_DIG_DLL */
					0x00008000 /* EMC_CFG_DIG_DLL_PERIOD */
					0x000fc000 /* EMC_DLL_XFORM_DQS0 */
					0x000fc000 /* EMC_DLL_XFORM_DQS1 */
					0x000fc000 /* EMC_DLL_XFORM_DQS2 */
					0x000fc000 /* EMC_DLL_XFORM_DQS3 */
					0x000fc000 /* EMC_DLL_XFORM_DQS4 */
					0x000fc000 /* EMC_DLL_XFORM_DQS5 */
					0x000fc000 /* EMC_DLL_XFORM_DQS6 */
					0x000fc000 /* EMC_DLL_XFORM_DQS7 */
					0x00000000 /* EMC_DLL_XFORM_QUSE0 */
					0x00000000 /* EMC_DLL_XFORM_QUSE1 */
					0x00000000 /* EMC_DLL_XFORM_QUSE2 */
					0x00000000 /* EMC_DLL_XFORM_QUSE3 */
					0x00000000 /* EMC_DLL_XFORM_QUSE4 */
					0x00000000 /* EMC_DLL_XFORM_QUSE5 */
					0x00000000 /* EMC_DLL_XFORM_QUSE6 */
					0x00000000 /* EMC_DLL_XFORM_QUSE7 */
					0x00000000 /* EMC_DLI_TRIM_TXDQS0 */
					0x00000000 /* EMC_DLI_TRIM_TXDQS1 */
					0x00000000 /* EMC_DLI_TRIM_TXDQS2 */
					0x00000000 /* EMC_DLI_TRIM_TXDQS3 */
					0x00000000 /* EMC_DLI_TRIM_TXDQS4 */
					0x00000000 /* EMC_DLI_TRIM_TXDQS5 */
					0x00000000 /* EMC_DLI_TRIM_TXDQS6 */
					0x00000000 /* EMC_DLI_TRIM_TXDQS7 */
					0x000fc000 /* EMC_DLL_XFORM_DQ0 */
					0x000fc000 /* EMC_DLL_XFORM_DQ1 */
					0x000fc000 /* EMC_DLL_XFORM_DQ2 */
					0x000fc000 /* EMC_DLL_XFORM_DQ3 */
					0x000002a0 /* EMC_XM2CMDPADCTRL */
					0x0800211c /* EMC_XM2DQSPADCTRL2 */
					0x00000000 /* EMC_XM2DQPADCTRL2 */
					0x77fff884 /* EMC_XM2CLKPADCTRL */
					0x01f1f108 /* EMC_XM2COMPPADCTRL */
					0x05057404 /* EMC_XM2VTTGENPADCTRL */
					0x54000007 /* EMC_XM2VTTGENPADCTRL2 */
					0x08000168 /* EMC_XM2QUSEPADCTRL */
					0x08000000 /* EMC_XM2DQSPADCTRL3 */
					0x00000802 /* EMC_CTT_TERM_CTRL */
					0x00000000 /* EMC_ZCAL_INTERVAL */
					0x00000040 /* EMC_ZCAL_WAIT_CNT */
					0x000c000c /* EMC_MRS_WAIT_CNT */
					0xa0f10000 /* EMC_AUTO_CAL_CONFIG */
					0x00000000 /* EMC_CTT */
					0x00000000 /* EMC_CTT_DURATION */
					0x80000713 /* EMC_DYN_SELF_REF_CONTROL */
					0x00000003 /* MC_EMEM_ARB_CFG */
					0xc0000018 /* MC_EMEM_ARB_OUTSTANDING_REQ */
					0x00000001 /* MC_EMEM_ARB_TIMING_RCD */
					0x00000001 /* MC_EMEM_ARB_TIMING_RP */
					0x00000003 /* MC_EMEM_ARB_TIMING_RC */
					0x00000000 /* MC_EMEM_ARB_TIMING_RAS */
					0x00000002 /* MC_EMEM_ARB_TIMING_FAW */
					0x00000001 /* MC_EMEM_ARB_TIMING_RRD */
					0x00000003 /* MC_EMEM_ARB_TIMING_RAP2PRE */
					0x00000008 /* MC_EMEM_ARB_TIMING_WAP2PRE */
					0x00000002 /* MC_EMEM_ARB_TIMING_R2R */
					0x00000001 /* MC_EMEM_ARB_TIMING_W2W */
					0x00000002 /* MC_EMEM_ARB_TIMING_R2W */
					0x00000006 /* MC_EMEM_ARB_TIMING_W2R */
					0x06020102 /* MC_EMEM_ARB_DA_TURNS */
					0x000a0503 /* MC_EMEM_ARB_DA_COVERS */
					0x73c30504 /* MC_EMEM_ARB_MISC0 */
					0x001f0000 /* MC_EMEM_ARB_RING1_THROTTLE */
					0xe8000000 /* EMC_FBIO_SPARE */
					0xff00ff00 /* EMC_CFG_RSV */
				>;
			};

			timing-20400000 {
				clock-frequency = <20400000>;

				nvidia,emc-zcal-cnt-long = <0x00000040>;
				nvidia,emc-auto-cal-interval = <0x001fffff>;
				nvidia,emc-mode-reset = <0x80001221>;
				nvidia,emc-mode-1 = <0x80100003>;
				nvidia,emc-mode-2 = <0x80200008>;

				nvidia,emem-configuration = <
					0x00000009 /* EMC_RC */
					0x00000035 /* EMC_RFC */
					0x00000007 /* EMC_RAS */
					0x00000002 /* EMC_RP */
					0x00000002 /* EMC_R2W */
					0x0000000a /* EMC_W2R */
					0x00000005 /* EMC_R2P */
					0x0000000b /* EMC_W2P */
					0x00000002 /* EMC_RD_RCD */
					0x00000002 /* EMC_WR_RCD */
					0x00000003 /* EMC_RRD */
					0x00000001 /* EMC_REXT */
					0x00000000 /* EMC_WEXT */
					0x00000005 /* EMC_WDV */
					0x00000005 /* EMC_QUSE */
					0x00000004 /* EMC_QRST */
					0x0000000a /* EMC_QSAFE */
					0x0000000b /* EMC_RDV */
					0x00000607 /* EMC_REFRESH */
					0x00000000 /* EMC_BURST_REFRESH_NUM */
					0x00000181 /* EMC_PRE_REFRESH_REQ_CNT */
					0x00000002 /* EMC_PDEX2WR */
					0x00000002 /* EMC_PDEX2RD */
					0x00000001 /* EMC_PCHG2PDEN */
					0x00000000 /* EMC_ACT2PDEN */
					0x00000007 /* EMC_AR2PDEN */
					0x0000000f /* EMC_RW2PDEN */
					0x00000038 /* EMC_TXSR */
					0x00000038 /* EMC_TXSRDLL */
					0x00000004 /* EMC_TCKE */
					0x00000009 /* EMC_TFAW */
					0x00000000 /* EMC_TRPAB */
					0x00000004 /* EMC_TCLKSTABLE */
					0x00000005 /* EMC_TCLKSTOP */
					0x00000638 /* EMC_TREFBW */
					0x00000006 /* EMC_QUSE_EXTRA */
					0x00000006 /* EMC_FBIO_CFG6 */
					0x00000000 /* EMC_ODT_WRITE */
					0x00000000 /* EMC_ODT_READ */
					0x00004288 /* EMC_FBIO_CFG5 */
					0x004400a4 /* EMC_CFG_DIG_DLL */
					0x00008000 /* EMC_CFG_DIG_DLL_PERIOD */
					0x00080000 /* EMC_DLL_XFORM_DQS0 */
					0x00080000 /* EMC_DLL_XFORM_DQS1 */
					0x00080000 /* EMC_DLL_XFORM_DQS2 */
					0x00080000 /* EMC_DLL_XFORM_DQS3 */
					0x00080000 /* EMC_DLL_XFORM_DQS4 */
					0x00080000 /* EMC_DLL_XFORM_DQS5 */
					0x00080000 /* EMC_DLL_XFORM_DQS6 */
					0x00080000 /* EMC_DLL_XFORM_DQS7 */
					0x00000000 /* EMC_DLL_XFORM_QUSE0 */
					0x00000000 /* EMC_DLL_XFORM_QUSE1 */
					0x00000000 /* EMC_DLL_XFORM_QUSE2 */
					0x00000000 /* EMC_DLL_XFORM_QUSE3 */
					0x00000000 /* EMC_DLL_XFORM_QUSE4 */
					0x00000000 /* EMC_DLL_XFORM_QUSE5 */
					0x00000000 /* EMC_DLL_XFORM_QUSE6 */
					0x00000000 /* EMC_DLL_XFORM_QUSE7 */
					0x00000000 /* EMC_DLI_TRIM_TXDQS0 */
					0x00000000 /* EMC_DLI_TRIM_TXDQS1 */
					0x00000000 /* EMC_DLI_TRIM_TXDQS2 */
					0x00000000 /* EMC_DLI_TRIM_TXDQS3 */
					0x00000000 /* EMC_DLI_TRIM_TXDQS4 */
					0x00000000 /* EMC_DLI_TRIM_TXDQS5 */
					0x00000000 /* EMC_DLI_TRIM_TXDQS6 */
					0x00000000 /* EMC_DLI_TRIM_TXDQS7 */
					0x00080000 /* EMC_DLL_XFORM_DQ0 */
					0x00080000 /* EMC_DLL_XFORM_DQ1 */
					0x00080000 /* EMC_DLL_XFORM_DQ2 */
					0x00080000 /* EMC_DLL_XFORM_DQ3 */
					0x000002a0 /* EMC_XM2CMDPADCTRL */
					0x0800211c /* EMC_XM2DQSPADCTRL2 */
					0x00000000 /* EMC_XM2DQPADCTRL2 */
					0x77fff884 /* EMC_XM2CLKPADCTRL */
					0x01f1f108 /* EMC_XM2COMPPADCTRL */
					0x05057404 /* EMC_XM2VTTGENPADCTRL */
					0x54000007 /* EMC_XM2VTTGENPADCTRL2 */
					0x08000168 /* EMC_XM2QUSEPADCTRL */
					0x08000000 /* EMC_XM2DQSPADCTRL3 */
					0x00000802 /* EMC_CTT_TERM_CTRL */
					0x00020000 /* EMC_ZCAL_INTERVAL */
					0x00000100 /* EMC_ZCAL_WAIT_CNT */
					0x000c000c /* EMC_MRS_WAIT_CNT */
					0xa0f10000 /* EMC_AUTO_CAL_CONFIG */
					0x00000000 /* EMC_CTT */
					0x00000000 /* EMC_CTT_DURATION */
					0x80000d22 /* EMC_DYN_SELF_REF_CONTROL */
					0x00000006 /* MC_EMEM_ARB_CFG */
					0xc0000025 /* MC_EMEM_ARB_OUTSTANDING_REQ */
					0x00000001 /* MC_EMEM_ARB_TIMING_RCD */
					0x00000001 /* MC_EMEM_ARB_TIMING_RP */
					0x00000005 /* MC_EMEM_ARB_TIMING_RC */
					0x00000002 /* MC_EMEM_ARB_TIMING_RAS */
					0x00000004 /* MC_EMEM_ARB_TIMING_FAW */
					0x00000001 /* MC_EMEM_ARB_TIMING_RRD */
					0x00000003 /* MC_EMEM_ARB_TIMING_RAP2PRE */
					0x00000008 /* MC_EMEM_ARB_TIMING_WAP2PRE */
					0x00000002 /* MC_EMEM_ARB_TIMING_R2R */
					0x00000001 /* MC_EMEM_ARB_TIMING_W2W */
					0x00000002 /* MC_EMEM_ARB_TIMING_R2W */
					0x00000006 /* MC_EMEM_ARB_TIMING_W2R */
					0x06020102 /* MC_EMEM_ARB_DA_TURNS */
					0x000a0505 /* MC_EMEM_ARB_DA_COVERS */
					0x73840a06 /* MC_EMEM_ARB_MISC0 */
					0x001f0000 /* MC_EMEM_ARB_RING1_THROTTLE */
					0xe8000000 /* EMC_FBIO_SPARE */
					0xff00ff00 /* EMC_CFG_RSV */
				>;
			};
			timing-40000000 {
				clock-frequency = <40000000>;

				nvidia,emc-zcal-cnt-long = <0x00000040>;
				nvidia,emc-auto-cal-interval = <0x001fffff>;
				nvidia,emc-mode-reset = <0x80000521>;
				nvidia,emc-mode-1 = <0x80100002>;
				nvidia,emc-mode-2 = <0x80200000>;

				nvidia,emem-configuration = <
					0x00000012 /* EMC_RC */
					0x00000066 /* EMC_RFC */
					0x0000000c /* EMC_RAS */
					0x00000004 /* EMC_RP */
					0x00000003 /* EMC_R2W */
					0x00000008 /* EMC_W2R */
					0x00000002 /* EMC_R2P */
					0x0000000a /* EMC_W2P */
					0x00000004 /* EMC_RD_RCD */
					0x00000004 /* EMC_WR_RCD */
					0x00000002 /* EMC_RRD */
					0x00000001 /* EMC_REXT */
					0x00000000 /* EMC_WEXT */
					0x00000004 /* EMC_WDV */
					0x00000006 /* EMC_QUSE */
					0x00000004 /* EMC_QRST */
					0x0000000a /* EMC_QSAFE */
					0x0000000c /* EMC_RDV */
					0x00000bf0 /* EMC_REFRESH */
					0x00000000 /* EMC_BURST_REFRESH_NUM */
					0x000002fc /* EMC_PRE_REFRESH_REQ_CNT */
					0x00000001 /* EMC_PDEX2WR */
					0x00000008 /* EMC_PDEX2RD */
					0x00000001 /* EMC_PCHG2PDEN */
					0x00000000 /* EMC_ACT2PDEN */
					0x00000008 /* EMC_AR2PDEN */
					0x0000000f /* EMC_RW2PDEN */
					0x0000006c /* EMC_TXSR */
					0x00000200 /* EMC_TXSRDLL */
					0x00000004 /* EMC_TCKE */
					0x00000010 /* EMC_TFAW */
					0x00000000 /* EMC_TRPAB */
					0x00000004 /* EMC_TCLKSTABLE */
					0x00000005 /* EMC_TCLKSTOP */
					0x00000c30 /* EMC_TREFBW */
					0x00000000 /* EMC_QUSE_EXTRA */
					0x00000004 /* EMC_FBIO_CFG6 */
					0x00000000 /* EMC_ODT_WRITE */
					0x00000000 /* EMC_ODT_READ */
					0x00007088 /* EMC_FBIO_CFG5 */
					0x001d0084 /* EMC_CFG_DIG_DLL */
					0x00008000 /* EMC_CFG_DIG_DLL_PERIOD */
					0x0003c000 /* EMC_DLL_XFORM_DQS0 */
					0x0003c000 /* EMC_DLL_XFORM_DQS1 */
					0x0003c000 /* EMC_DLL_XFORM_DQS2 */
					0x0003c000 /* EMC_DLL_XFORM_DQS3 */
					0x0003c000 /* EMC_DLL_XFORM_DQS4 */
					0x0003c000 /* EMC_DLL_XFORM_DQS5 */
					0x0003c000 /* EMC_DLL_XFORM_DQS6 */
					0x000c000 /* EMC_DLL_XFORM_DQS7 */
					0x00000000 /* EMC_DLL_XFORM_QUSE0 */
					0x00000000 /* EMC_DLL_XFORM_QUSE1 */
					0x00000000 /* EMC_DLL_XFORM_QUSE2 */
					0x00000000 /* EMC_DLL_XFORM_QUSE3 */
					0x00000000 /* EMC_DLL_XFORM_QUSE4 */
					0x00000000 /* EMC_DLL_XFORM_QUSE5 */
					0x00000000 /* EMC_DLL_XFORM_QUSE6 */
					0x00000000 /* EMC_DLL_XFORM_QUSE7 */
					0x00000000 /* EMC_DLI_TRIM_TXDQS0 */
					0x00000000 /* EMC_DLI_TRIM_TXDQS1 */
					0x00000000 /* EMC_DLI_TRIM_TXDQS2 */
					0x00000000 /* EMC_DLI_TRIM_TXDQS3 */
					0x00000000 /* EMC_DLI_TRIM_TXDQS4 */
					0x00000000 /* EMC_DLI_TRIM_TXDQS5 */
					0x00000000 /* EMC_DLI_TRIM_TXDQS6 */
					0x00000000 /* EMC_DLI_TRIM_TXDQS7 */
					0x00048000 /* EMC_DLL_XFORM_DQ0 */
					0x00048000 /* EMC_DLL_XFORM_DQ1 */
					0x00048000 /* EMC_DLL_XFORM_DQ2 */
					0x00048000 /* EMC_DLL_XFORM_DQ3 */
					0x000002a0 /* EMC_XM2CMDPADCTRL */
					0x0800013d /* EMC_XM2DQSPADCTRL2 */
					0x00000000 /* EMC_XM2DQPADCTRL2 */
					0x77fff884 /* EMC_XM2CLKPADCTRL */
					0x01f1f508 /* EMC_XM2COMPPADCTRL */
					0x05057404 /* EMC_XM2VTTGENPADCTRL */
					0x54000007 /* EMC_XM2VTTGENPADCTRL2 */
					0x080001e8 /* EMC_XM2QUSEPADCTRL */
					0x08000021 /* EMC_XM2DQSPADCTRL3 */
					0x00000802 /* EMC_CTT_TERM_CTRL */
					0x00020000 /* EMC_ZCAL_INTERVAL */
					0x00000100 /* EMC_ZCAL_WAIT_CNT */
					0x0158000c /* EMC_MRS_WAIT_CNT */
					0xa0f10000 /* EMC_AUTO_CAL_CONFIG */
					0x00000000 /* EMC_CTT */
					0x00000000 /* EMC_CTT_DURATION */
					0x800018c8 /* EMC_DYN_SELF_REF_CONTROL */
					0x0000000c /* MC_EMEM_ARB_CFG */
					0xc0000048 /* MC_EMEM_ARB_OUTSTANDING_REQ */
					0x00000001 /* MC_EMEM_ARB_TIMING_RCD */
					0x00000002 /* MC_EMEM_ARB_TIMING_RP */
					0x00000009 /* MC_EMEM_ARB_TIMING_RC */
					0x00000005 /* MC_EMEM_ARB_TIMING_RAS */
					0x00000007 /* MC_EMEM_ARB_TIMING_FAW */
					0x00000001 /* MC_EMEM_ARB_TIMING_RRD */
					0x00000002 /* MC_EMEM_ARB_TIMING_RAP2PRE */
					0x00000008 /* MC_EMEM_ARB_TIMING_WAP2PRE */
					0x00000002 /* MC_EMEM_ARB_TIMING_R2R */
					0x00000002 /* MC_EMEM_ARB_TIMING_W2W */
					0x00000003 /* MC_EMEM_ARB_TIMING_R2W */
					0x00000006 /* MC_EMEM_ARB_TIMING_W2R */
					0x06030202 /* MC_EMEM_ARB_DA_TURNS */
					0x000d0709 /* MC_EMEM_ARB_DA_COVERS */
					0x7086120a /* MC_EMEM_ARB_MISC0 */
					0x001f0000 /* MC_EMEM_ARB_RING1_THROTTLE */
					0xe8000000 /* EMC_FBIO_SPARE */
					0xff00ff89 /* EMC_CFG_RSV */
				>;
			};
*/			timing-80000000 {
				clock-frequency = <80000000>;

				nvidia,emc-zcal-cnt-long = <0x00000040>;
				nvidia,emc-auto-cal-interval = <0x001fffff>;
				nvidia,emc-mode-reset = <0x80000d71>;
				nvidia,emc-mode-1 = <0x80100002>;
				nvidia,emc-mode-2 = <0x80200018>;

				nvidia,emem-configuration = <
					0x00000025 /* EMC_RC */
					0x000000ce /* EMC_RFC */
					0x0000001a /* EMC_RAS */
					0x00000009 /* EMC_RP */
					0x00000005 /* EMC_R2W */
					0x0000000d /* EMC_W2R */
					0x00000004 /* EMC_R2P */
					0x00000013 /* EMC_W2P */
					0x00000009 /* EMC_RD_RCD */
					0x00000009 /* EMC_WR_RCD */
					0x00000004 /* EMC_RRD */
					0x00000001 /* EMC_REXT */
					0x00000000 /* EMC_WEXT */
					0x00000007 /* EMC_WDV */
					0x0000000a /* EMC_QUSE */
					0x00000009 /* EMC_QRST */
					0x0000000b /* EMC_QSAFE */
					0x00000011 /* EMC_RDV */
					0x00001820 /* EMC_REFRESH */
					0x00000000 /* EMC_BURST_REFRESH_NUM */
					0x00000608 /* EMC_PRE_REFRESH_REQ_CNT */
					0x00000003 /* EMC_PDEX2WR */
					0x00000012 /* EMC_PDEX2RD */
					0x00000001 /* EMC_PCHG2PDEN */
					0x00000000 /* EMC_ACT2PDEN */
					0x0000000f /* EMC_AR2PDEN */
					0x00000018 /* EMC_RW2PDEN */
					0x000000d8 /* EMC_TXSR */
					0x00000200 /* EMC_TXSRDLL */
					0x00000005 /* EMC_TCKE */
					0x00000020 /* EMC_TFAW */
					0x00000000 /* EMC_TRPAB */
					0x00000007 /* EMC_TCLKSTABLE */
					0x00000008 /* EMC_TCLKSTOP */
					0x00001860 /* EMC_TREFBW */
					0x0000000b /* EMC_QUSE_EXTRA */
					0x00000006 /* EMC_FBIO_CFG6 */
					0x00000000 /* EMC_ODT_WRITE */
					0x00000000 /* EMC_ODT_READ */
					0x00005088 /* EMC_FBIO_CFG5 */
					0xf0070191 /* EMC_CFG_DIG_DLL */
					0x00008000 /* EMC_CFG_DIG_DLL_PERIOD */
					0x0000800a /* EMC_DLL_XFORM_DQS0 */
					0x0000000a /* EMC_DLL_XFORM_DQS1 */
					0x0000000a /* EMC_DLL_XFORM_DQS2 */
					0x0000000a /* EMC_DLL_XFORM_DQS3 */
					0x0000000a /* EMC_DLL_XFORM_DQS4 */
					0x0000000a /* EMC_DLL_XFORM_DQS5 */
					0x0000000a /* EMC_DLL_XFORM_DQS6 */
					0x0000000a /* EMC_DLL_XFORM_DQS7 */
					0x00018000 /* EMC_DLL_XFORM_QUSE0 */
					0x00018000 /* EMC_DLL_XFORM_QUSE1 */
					0x00018000 /* EMC_DLL_XFORM_QUSE2 */
					0x00018000 /* EMC_DLL_XFORM_QUSE3 */
					0x00018000 /* EMC_DLL_XFORM_QUSE4 */
					0x00018000 /* EMC_DLL_XFORM_QUSE5 */
					0x00018000 /* EMC_DLL_XFORM_QUSE6 */
					0x00018000 /* EMC_DLL_XFORM_QUSE7 */
					0x00000000 /* EMC_DLI_TRIM_TXDQS0 */
					0x00000000 /* EMC_DLI_TRIM_TXDQS1 */
					0x00000000 /* EMC_DLI_TRIM_TXDQS2 */
					0x00000000 /* EMC_DLI_TRIM_TXDQS3 */
					0x00000000 /* EMC_DLI_TRIM_TXDQS4 */
					0x00000000 /* EMC_DLI_TRIM_TXDQS5 */
					0x00000000 /* EMC_DLI_TRIM_TXDQS6 */
					0x00000000 /* EMC_DLI_TRIM_TXDQS7 */
					0x0000000a /* EMC_DLL_XFORM_DQ0 */
					0x0000000a /* EMC_DLL_XFORM_DQ1 */
					0x0000000a /* EMC_DLL_XFORM_DQ2 */
					0x0000000a /* EMC_DLL_XFORM_DQ3 */
					0x000002a0 /* EMC_XM2CMDPADCTRL */
					0x0600013d /* EMC_XM2DQSPADCTRL2 */
					0x22220000 /* EMC_XM2DQPADCTRL2 */
					0x77fff884 /* EMC_XM2CLKPADCTRL */
					0x01f1f501 /* EMC_XM2COMPPADCTRL */
					0x07077404 /* EMC_XM2VTTGENPADCTRL */
					0x54000000 /* EMC_XM2VTTGENPADCTRL2 */
					0x080001e8 /* EMC_XM2QUSEPADCTRL */
					0x08000021 /* EMC_XM2DQSPADCTRL3 */
					0x00000802 /* EMC_CTT_TERM_CTRL */
					0x00020000 /* EMC_ZCAL_INTERVAL */
					0x00000100 /* EMC_ZCAL_WAIT_CNT */
					0x00f0000c /* EMC_MRS_WAIT_CNT */
					0xa0f10000 /* EMC_AUTO_CAL_CONFIG */
					0x00000000 /* EMC_CTT */
					0x00000000 /* EMC_CTT_DURATION */
					0x8000308c /* EMC_DYN_SELF_REF_CONTROL */
					0x00000018 /* MC_EMEM_ARB_CFG */
					0xc0000090 /* MC_EMEM_ARB_OUTSTANDING_REQ */
					0x00000004 /* MC_EMEM_ARB_TIMING_RCD */
					0x00000005 /* MC_EMEM_ARB_TIMING_RP */
					0x00000013 /* MC_EMEM_ARB_TIMING_RC */
					0x0000000c /* MC_EMEM_ARB_TIMING_RAS */
					0x0000000f /* MC_EMEM_ARB_TIMING_FAW */
					0x00000002 /* MC_EMEM_ARB_TIMING_RRD */
					0x00000003 /* MC_EMEM_ARB_TIMING_RAP2PRE */
					0x0000000c /* MC_EMEM_ARB_TIMING_WAP2PRE */
					0x00000002 /* MC_EMEM_ARB_TIMING_R2R */
					0x00000002 /* MC_EMEM_ARB_TIMING_W2W */
					0x00000004 /* MC_EMEM_ARB_TIMING_R2W */
					0x00000008 /* MC_EMEM_ARB_TIMING_W2R */
					0x08040202 /* MC_EMEM_ARB_DA_TURNS */
					0x00160d13 /* MC_EMEM_ARB_DA_COVERS */
					0x712c2414 /* MC_EMEM_ARB_MISC0 */
					0x001f0000 /* MC_EMEM_ARB_RING1_THROTTLE */
					0xe8000000 /* EMC_FBIO_SPARE */
					0xff00ff49 /* EMC_CFG_RSV */
				>;
			};
		};
	};

	emc: memory-controller@7000f400 {
		compatible = "nvidia,tegra30-emc";
		reg = <0x7000f400 0x200>;
		#address-cells = <1>;
		#size-cells = <0>;
		nvidia,memory-controller = <&mc>;

		emc-timings-0 {
			nvidia,ram-code = <0>;
			timing-2550000 {
				clock-frequency = <2550000>;

				nvidia,emc-zcal-cnt-long = <0x00000040>;
				nvidia,emc-auto-cal-interval = <0x001fffff>;
				nvidia,emc-mode-reset = <0x80001221>;
				nvidia,emc-mode-1 = <0x80100003>;
				nvidia,emc-mode-2 = <0x80200008>;
				nvidia,emc-auto-cal-config = <0xa0f10000>;
			
				nvidia,emc-configuration = <
					0x00000001 /* EMC_RC */
					0x00000006 /* EMC_RFC */
					0x00000000 /* EMC_RAS */
					0x00000000 /* EMC_RP */
					0x00000002 /* EMC_R2W */
					0x0000000a /* EMC_W2R */
					0x00000005 /* EMC_R2P */
					0x0000000b /* EMC_W2P */
					0x00000000 /* EMC_RD_RCD */
					0x00000000 /* EMC_WR_RCD */
					0x00000003 /* EMC_RRD */
					0x00000001 /* EMC_REXT */
					0x00000000 /* EMC_WEXT */
					0x00000005 /* EMC_WDV */
					0x00000005 /* EMC_QUSE */
					0x00000004 /* EMC_QRST */
					0x0000000a /* EMC_QSAFE */
					0x0000000b /* EMC_RDV */
					0x000000c0 /* EMC_REFRESH */
					0x00000000 /* EMC_BURST_REFRESH_NUM */
					0x00000030 /* EMC_PRE_REFRESH_REQ_CNT */
					0x00000002 /* EMC_PDEX2WR */
					0x00000002 /* EMC_PDEX2RD */
					0x00000001 /* EMC_PCHG2PDEN */
					0x00000000 /* EMC_ACT2PDEN */
					0x00000007 /* EMC_AR2PDEN */
					0x0000000f /* EMC_RW2PDEN */
					0x00000007 /* EMC_TXSR */
					0x00000007 /* EMC_TXSRDLL */
					0x00000004 /* EMC_TCKE */
					0x00000002 /* EMC_TFAW */
					0x00000000 /* EMC_TRPAB */
					0x00000004 /* EMC_TCLKSTABLE */
					0x00000005 /* EMC_TCLKSTOP */
					0x000000c7 /* EMC_TREFBW */
					0x00000006 /* EMC_QUSE_EXTRA */
					0x00000004 /* EMC_FBIO_CFG6 */
					0x00000000 /* EMC_ODT_WRITE */
					0x00000000 /* EMC_ODT_READ */
					0x00004288 /* EMC_FBIO_CFG5 */
					0x007800a4 /* EMC_CFG_DIG_DLL */
					0x00008000 /* EMC_CFG_DIG_DLL_PERIOD */
					0x000fc000 /* EMC_DLL_XFORM_DQS0 */
					0x000fc000 /* EMC_DLL_XFORM_DQS1 */
					0x000fc000 /* EMC_DLL_XFORM_DQS2 */
					0x000fc000 /* EMC_DLL_XFORM_DQS3 */
					0x000fc000 /* EMC_DLL_XFORM_DQS4 */
					0x000fc000 /* EMC_DLL_XFORM_DQS5 */
					0x000fc000 /* EMC_DLL_XFORM_DQS6 */
					0x000fc000 /* EMC_DLL_XFORM_DQS7 */
					0x00000000 /* EMC_DLL_XFORM_QUSE0 */
					0x00000000 /* EMC_DLL_XFORM_QUSE1 */
					0x00000000 /* EMC_DLL_XFORM_QUSE2 */
					0x00000000 /* EMC_DLL_XFORM_QUSE3 */
					0x00000000 /* EMC_DLL_XFORM_QUSE4 */
					0x00000000 /* EMC_DLL_XFORM_QUSE5 */
					0x00000000 /* EMC_DLL_XFORM_QUSE6 */
					0x00000000 /* EMC_DLL_XFORM_QUSE7 */
					0x00000000 /* EMC_DLI_TRIM_TXDQS0 */
					0x00000000 /* EMC_DLI_TRIM_TXDQS1 */
					0x00000000 /* EMC_DLI_TRIM_TXDQS2 */
					0x00000000 /* EMC_DLI_TRIM_TXDQS3 */
					0x00000000 /* EMC_DLI_TRIM_TXDQS4 */
					0x00000000 /* EMC_DLI_TRIM_TXDQS5 */
					0x00000000 /* EMC_DLI_TRIM_TXDQS6 */
					0x00000000 /* EMC_DLI_TRIM_TXDQS7 */
					0x000fc000 /* EMC_DLL_XFORM_DQ0 */
					0x000fc000 /* EMC_DLL_XFORM_DQ1 */
					0x000fc000 /* EMC_DLL_XFORM_DQ2 */
					0x000fc000 /* EMC_DLL_XFORM_DQ3 */
					0x000002a0 /* EMC_XM2CMDPADCTRL */
					0x0800211c /* EMC_XM2DQSPADCTRL2 */
					0x00000000 /* EMC_XM2DQPADCTRL2 */
					0x77fff884 /* EMC_XM2CLKPADCTRL */
					0x01f1f108 /* EMC_XM2COMPPADCTRL */
					0x05057404 /* EMC_XM2VTTGENPADCTRL */
					0x54000007 /* EMC_XM2VTTGENPADCTRL2 */
					0x08000168 /* EMC_XM2QUSEPADCTRL */
					0x08000000 /* EMC_XM2DQSPADCTRL3 */
					0x00000802 /* EMC_CTT_TERM_CTRL */
					0x00000000 /* EMC_ZCAL_INTERVAL */
					0x00000040 /* EMC_ZCAL_WAIT_CNT */
					0x000c000c /* EMC_MRS_WAIT_CNT */
					0xa0f10000 /* EMC_AUTO_CAL_CONFIG */
					0x00000000 /* EMC_CTT */
					0x00000000 /* EMC_CTT_DURATION */
					0x80000287 /* EMC_DYN_SELF_REF_CONTROL */
					0x00030003 /* MC_EMEM_ARB_CFG */
					0xc0000010 /* MC_EMEM_ARB_OUTSTANDING_REQ */
					0x00000001 /* MC_EMEM_ARB_TIMING_RCD */
					0x00000001 /* MC_EMEM_ARB_TIMING_RP */
					0x00000002 /* MC_EMEM_ARB_TIMING_RC */
					0x00000000 /* MC_EMEM_ARB_TIMING_RAS */
					0x00000001 /* MC_EMEM_ARB_TIMING_FAW */
					0x00000001 /* MC_EMEM_ARB_TIMING_RRD */
					0x00000003 /* MC_EMEM_ARB_TIMING_RAP2PRE */
					0x00000008 /* MC_EMEM_ARB_TIMING_WAP2PRE */
					0x00000002 /* MC_EMEM_ARB_TIMING_R2R */
					0x00000001 /* MC_EMEM_ARB_TIMING_W2W */
					0x00000002 /* MC_EMEM_ARB_TIMING_R2W */
					0x00000006 /* MC_EMEM_ARB_TIMING_W2R */
					0x06020102 /* MC_EMEM_ARB_DA_TURNS */
					0x000a0502 /* MC_EMEM_ARB_DA_COVERS */
					0x75830303 /* MC_EMEM_ARB_MISC0 */
					0x001f0000 /* MC_EMEM_ARB_RING1_THROTTLE */
					0xe8000000 /* EMC_FBIO_SPARE */
					0xff00ff00 /* EMC_CFG_RSV */
				>;
			};
			timing-5100000 {
				clock-frequency = <5100000>;

				nvidia,emc-zcal-cnt-long = <0x00000040>;
				nvidia,emc-auto-cal-interval = <0x001fffff>;
				nvidia,emc-mode-reset = <0x80001221>;
				nvidia,emc-mode-1 = <0x80100003>;
				nvidia,emc-mode-2 = <0x80200008>;

				nvidia,emc-configuration = <
					0x00000002 /* EMC_RC */
					0x0000000d /* EMC_RFC */
					0x00000001 /* EMC_RAS */
					0x00000000 /* EMC_RP */
					0x00000002 /* EMC_R2W */
					0x0000000a /* EMC_W2R */
					0x00000005 /* EMC_R2P */
					0x0000000b /* EMC_W2P */
					0x00000000 /* EMC_RD_RCD */
					0x00000000 /* EMC_WR_RCD */
					0x00000003 /* EMC_RRD */
					0x00000001 /* EMC_REXT */
					0x00000000 /* EMC_WEXT */
					0x00000005 /* EMC_WDV */
					0x00000005 /* EMC_QUSE */
					0x00000004 /* EMC_QRST */
					0x0000000a /* EMC_QSAFE */
					0x0000000b /* EMC_RDV */
					0x00000181 /* EMC_REFRESH */
					0x00000000 /* EMC_BURST_REFRESH_NUM */
					0x00000060 /* EMC_PRE_REFRESH_REQ_CNT */
					0x00000002 /* EMC_PDEX2WR */
					0x00000002 /* EMC_PDEX2RD */
					0x00000001 /* EMC_PCHG2PDEN */
					0x00000000 /* EMC_ACT2PDEN */
					0x00000007 /* EMC_AR2PDEN */
					0x0000000f /* EMC_RW2PDEN */
					0x0000000e /* EMC_TXSR */
					0x0000000e /* EMC_TXSRDLL */
					0x00000004 /* EMC_TCKE */
					0x00000003 /* EMC_TFAW */
					0x00000000 /* EMC_TRPAB */
					0x00000004 /* EMC_TCLKSTABLE */
					0x00000005 /* EMC_TCLKSTOP */
					0x0000018e /* EMC_TREFBW */
					0x00000006 /* EMC_QUSE_EXTRA */
					0x00000004 /* EMC_FBIO_CFG6 */
					0x00000000 /* EMC_ODT_WRITE */
					0x00000000 /* EMC_ODT_READ */
					0x00004288 /* EMC_FBIO_CFG5 */
					0x007800a4 /* EMC_CFG_DIG_DLL */
					0x00008000 /* EMC_CFG_DIG_DLL_PERIOD */
					0x000fc000 /* EMC_DLL_XFORM_DQS0 */
					0x000fc000 /* EMC_DLL_XFORM_DQS1 */
					0x000fc000 /* EMC_DLL_XFORM_DQS2 */
					0x000fc000 /* EMC_DLL_XFORM_DQS3 */
					0x000fc000 /* EMC_DLL_XFORM_DQS4 */
					0x000fc000 /* EMC_DLL_XFORM_DQS5 */
					0x000fc000 /* EMC_DLL_XFORM_DQS6 */
					0x000fc000 /* EMC_DLL_XFORM_DQS7 */
					0x00000000 /* EMC_DLL_XFORM_QUSE0 */
					0x00000000 /* EMC_DLL_XFORM_QUSE1 */
					0x00000000 /* EMC_DLL_XFORM_QUSE2 */
					0x00000000 /* EMC_DLL_XFORM_QUSE3 */
					0x00000000 /* EMC_DLL_XFORM_QUSE4 */
					0x00000000 /* EMC_DLL_XFORM_QUSE5 */
					0x00000000 /* EMC_DLL_XFORM_QUSE6 */
					0x00000000 /* EMC_DLL_XFORM_QUSE7 */
					0x00000000 /* EMC_DLI_TRIM_TXDQS0 */
					0x00000000 /* EMC_DLI_TRIM_TXDQS1 */
					0x00000000 /* EMC_DLI_TRIM_TXDQS2 */
					0x00000000 /* EMC_DLI_TRIM_TXDQS3 */
					0x00000000 /* EMC_DLI_TRIM_TXDQS4 */
					0x00000000 /* EMC_DLI_TRIM_TXDQS5 */
					0x00000000 /* EMC_DLI_TRIM_TXDQS6 */
					0x00000000 /* EMC_DLI_TRIM_TXDQS7 */
					0x000fc000 /* EMC_DLL_XFORM_DQ0 */
					0x000fc000 /* EMC_DLL_XFORM_DQ1 */
					0x000fc000 /* EMC_DLL_XFORM_DQ2 */
					0x000fc000 /* EMC_DLL_XFORM_DQ3 */
					0x000002a0 /* EMC_XM2CMDPADCTRL */
					0x0800211c /* EMC_XM2DQSPADCTRL2 */
					0x00000000 /* EMC_XM2DQPADCTRL2 */
					0x77fff884 /* EMC_XM2CLKPADCTRL */
					0x01f1f108 /* EMC_XM2COMPPADCTRL */
					0x05057404 /* EMC_XM2VTTGENPADCTRL */
					0x54000007 /* EMC_XM2VTTGENPADCTRL2 */
					0x08000168 /* EMC_XM2QUSEPADCTRL */
					0x08000000 /* EMC_XM2DQSPADCTRL3 */
					0x00000802 /* EMC_CTT_TERM_CTRL */
					0x00000000 /* EMC_ZCAL_INTERVAL */
					0x00000040 /* EMC_ZCAL_WAIT_CNT */
					0x000c000c /* EMC_MRS_WAIT_CNT */
					0xa0f10000 /* EMC_AUTO_CAL_CONFIG */
					0x00000000 /* EMC_CTT */
					0x00000000 /* EMC_CTT_DURATION */
					0x8000040b /* EMC_DYN_SELF_REF_CONTROL */
					0x00010003 /* MC_EMEM_ARB_CFG */
					0xc0000010 /* MC_EMEM_ARB_OUTSTANDING_REQ */
					0x00000001 /* MC_EMEM_ARB_TIMING_RCD */
					0x00000001 /* MC_EMEM_ARB_TIMING_RP */
					0x00000002 /* MC_EMEM_ARB_TIMING_RC */
					0x00000000 /* MC_EMEM_ARB_TIMING_RAS */
					0x00000001 /* MC_EMEM_ARB_TIMING_FAW */
					0x00000001 /* MC_EMEM_ARB_TIMING_RRD */
					0x00000003 /* MC_EMEM_ARB_TIMING_RAP2PRE */
					0x00000008 /* MC_EMEM_ARB_TIMING_WAP2PRE */
					0x00000002 /* MC_EMEM_ARB_TIMING_R2R */
					0x00000001 /* MC_EMEM_ARB_TIMING_W2W */
					0x00000002 /* MC_EMEM_ARB_TIMING_R2W */
					0x00000006 /* MC_EMEM_ARB_TIMING_W2R */
					0x06020102 /* MC_EMEM_ARB_DA_TURNS */
					0x000a0502 /* MC_EMEM_ARB_DA_COVERS */
					0x74630303 /* MC_EMEM_ARB_MISC0 */
					0x001f0000 /* MC_EMEM_ARB_RING1_THROTTLE */
					0xe8000000 /* EMC_FBIO_SPARE */
					0xff00ff00 /* EMC_CFG_RSV */
				>;
			};
			timing-10200000 {
				clock-frequency = <10200000>;

				nvidia,emc-zcal-cnt-long = <0x00000040>;
				nvidia,emc-auto-cal-interval = <0x001fffff>;
				nvidia,emc-mode-reset = <0x80001221>;
				nvidia,emc-mode-1 = <0x80100003>;
				nvidia,emc-mode-2 = <0x80200008>;

				nvidia,emc-configuration = <
					0x00000004 /* EMC_RC */
					0x0000001a /* EMC_RFC */
					0x00000003 /* EMC_RAS */
					0x00000001 /* EMC_RP */
					0x00000002 /* EMC_R2W */
					0x0000000a /* EMC_W2R */
					0x00000005 /* EMC_R2P */
					0x0000000b /* EMC_W2P */
					0x00000001 /* EMC_RD_RCD */
					0x00000001 /* EMC_WR_RCD */
					0x00000003 /* EMC_RRD */
					0x00000001 /* EMC_REXT */
					0x00000000 /* EMC_WEXT */
					0x00000005 /* EMC_WDV */
					0x00000005 /* EMC_QUSE */
					0x00000004 /* EMC_QRST */
					0x0000000a /* EMC_QSAFE */
					0x0000000b /* EMC_RDV */
					0x00000303 /* EMC_REFRESH */
					0x00000000 /* EMC_BURST_REFRESH_NUM */
					0x000000c0 /* EMC_PRE_REFRESH_REQ_CNT */
					0x00000002 /* EMC_PDEX2WR */
					0x00000002 /* EMC_PDEX2RD */
					0x00000001 /* EMC_PCHG2PDEN */
					0x00000000 /* EMC_ACT2PDEN */
					0x00000007 /* EMC_AR2PDEN */
					0x0000000f /* EMC_RW2PDEN */
					0x0000001c /* EMC_TXSR */
					0x0000001c /* EMC_TXSRDLL */
					0x00000004 /* EMC_TCKE */
					0x00000005 /* EMC_TFAW */
					0x00000000 /* EMC_TRPAB */
					0x00000004 /* EMC_TCLKSTABLE */
					0x00000005 /* EMC_TCLKSTOP */
					0x0000031c /* EMC_TREFBW */
					0x00000006 /* EMC_QUSE_EXTRA */
					0x00000004 /* EMC_FBIO_CFG6 */
					0x00000000 /* EMC_ODT_WRITE */
					0x00000000 /* EMC_ODT_READ */
					0x00004288 /* EMC_FBIO_CFG5 */
					0x007800a4 /* EMC_CFG_DIG_DLL */
					0x00008000 /* EMC_CFG_DIG_DLL_PERIOD */
					0x000fc000 /* EMC_DLL_XFORM_DQS0 */
					0x000fc000 /* EMC_DLL_XFORM_DQS1 */
					0x000fc000 /* EMC_DLL_XFORM_DQS2 */
					0x000fc000 /* EMC_DLL_XFORM_DQS3 */
					0x000fc000 /* EMC_DLL_XFORM_DQS4 */
					0x000fc000 /* EMC_DLL_XFORM_DQS5 */
					0x000fc000 /* EMC_DLL_XFORM_DQS6 */
					0x000fc000 /* EMC_DLL_XFORM_DQS7 */
					0x00000000 /* EMC_DLL_XFORM_QUSE0 */
					0x00000000 /* EMC_DLL_XFORM_QUSE1 */
					0x00000000 /* EMC_DLL_XFORM_QUSE2 */
					0x00000000 /* EMC_DLL_XFORM_QUSE3 */
					0x00000000 /* EMC_DLL_XFORM_QUSE4 */
					0x00000000 /* EMC_DLL_XFORM_QUSE5 */
					0x00000000 /* EMC_DLL_XFORM_QUSE6 */
					0x00000000 /* EMC_DLL_XFORM_QUSE7 */
					0x00000000 /* EMC_DLI_TRIM_TXDQS0 */
					0x00000000 /* EMC_DLI_TRIM_TXDQS1 */
					0x00000000 /* EMC_DLI_TRIM_TXDQS2 */
					0x00000000 /* EMC_DLI_TRIM_TXDQS3 */
					0x00000000 /* EMC_DLI_TRIM_TXDQS4 */
					0x00000000 /* EMC_DLI_TRIM_TXDQS5 */
					0x00000000 /* EMC_DLI_TRIM_TXDQS6 */
					0x00000000 /* EMC_DLI_TRIM_TXDQS7 */
					0x000fc000 /* EMC_DLL_XFORM_DQ0 */
					0x000fc000 /* EMC_DLL_XFORM_DQ1 */
					0x000fc000 /* EMC_DLL_XFORM_DQ2 */
					0x000fc000 /* EMC_DLL_XFORM_DQ3 */
					0x000002a0 /* EMC_XM2CMDPADCTRL */
					0x0800211c /* EMC_XM2DQSPADCTRL2 */
					0x00000000 /* EMC_XM2DQPADCTRL2 */
					0x77fff884 /* EMC_XM2CLKPADCTRL */
					0x01f1f108 /* EMC_XM2COMPPADCTRL */
					0x05057404 /* EMC_XM2VTTGENPADCTRL */
					0x54000007 /* EMC_XM2VTTGENPADCTRL2 */
					0x08000168 /* EMC_XM2QUSEPADCTRL */
					0x08000000 /* EMC_XM2DQSPADCTRL3 */
					0x00000802 /* EMC_CTT_TERM_CTRL */
					0x00000000 /* EMC_ZCAL_INTERVAL */
					0x00000040 /* EMC_ZCAL_WAIT_CNT */
					0x000c000c /* EMC_MRS_WAIT_CNT */
					0xa0f10000 /* EMC_AUTO_CAL_CONFIG */
					0x00000000 /* EMC_CTT */
					0x00000000 /* EMC_CTT_DURATION */
					0x80000713 /* EMC_DYN_SELF_REF_CONTROL */
					0x00000003 /* MC_EMEM_ARB_CFG */
					0xc0000018 /* MC_EMEM_ARB_OUTSTANDING_REQ */
					0x00000001 /* MC_EMEM_ARB_TIMING_RCD */
					0x00000001 /* MC_EMEM_ARB_TIMING_RP */
					0x00000003 /* MC_EMEM_ARB_TIMING_RC */
					0x00000000 /* MC_EMEM_ARB_TIMING_RAS */
					0x00000002 /* MC_EMEM_ARB_TIMING_FAW */
					0x00000001 /* MC_EMEM_ARB_TIMING_RRD */
					0x00000003 /* MC_EMEM_ARB_TIMING_RAP2PRE */
					0x00000008 /* MC_EMEM_ARB_TIMING_WAP2PRE */
					0x00000002 /* MC_EMEM_ARB_TIMING_R2R */
					0x00000001 /* MC_EMEM_ARB_TIMING_W2W */
					0x00000002 /* MC_EMEM_ARB_TIMING_R2W */
					0x00000006 /* MC_EMEM_ARB_TIMING_W2R */
					0x06020102 /* MC_EMEM_ARB_DA_TURNS */
					0x000a0503 /* MC_EMEM_ARB_DA_COVERS */
					0x73c30504 /* MC_EMEM_ARB_MISC0 */
					0x001f0000 /* MC_EMEM_ARB_RING1_THROTTLE */
					0xe8000000 /* EMC_FBIO_SPARE */
					0xff00ff00 /* EMC_CFG_RSV */
				>;
			};

			timing-20400000 {
				clock-frequency = <20400000>;

				nvidia,emc-zcal-cnt-long = <0x00000040>;
				nvidia,emc-auto-cal-interval = <0x001fffff>;
				nvidia,emc-mode-reset = <0x80001221>;
				nvidia,emc-mode-1 = <0x80100003>;
				nvidia,emc-mode-2 = <0x80200008>;

				nvidia,emc-configuration = <
					0x00000009 /* EMC_RC */
					0x00000035 /* EMC_RFC */
					0x00000007 /* EMC_RAS */
					0x00000002 /* EMC_RP */
					0x00000002 /* EMC_R2W */
					0x0000000a /* EMC_W2R */
					0x00000005 /* EMC_R2P */
					0x0000000b /* EMC_W2P */
					0x00000002 /* EMC_RD_RCD */
					0x00000002 /* EMC_WR_RCD */
					0x00000003 /* EMC_RRD */
					0x00000001 /* EMC_REXT */
					0x00000000 /* EMC_WEXT */
					0x00000005 /* EMC_WDV */
					0x00000005 /* EMC_QUSE */
					0x00000004 /* EMC_QRST */
					0x0000000a /* EMC_QSAFE */
					0x0000000b /* EMC_RDV */
					0x00000607 /* EMC_REFRESH */
					0x00000000 /* EMC_BURST_REFRESH_NUM */
					0x00000181 /* EMC_PRE_REFRESH_REQ_CNT */
					0x00000002 /* EMC_PDEX2WR */
					0x00000002 /* EMC_PDEX2RD */
					0x00000001 /* EMC_PCHG2PDEN */
					0x00000000 /* EMC_ACT2PDEN */
					0x00000007 /* EMC_AR2PDEN */
					0x0000000f /* EMC_RW2PDEN */
					0x00000038 /* EMC_TXSR */
					0x00000038 /* EMC_TXSRDLL */
					0x00000004 /* EMC_TCKE */
					0x00000009 /* EMC_TFAW */
					0x00000000 /* EMC_TRPAB */
					0x00000004 /* EMC_TCLKSTABLE */
					0x00000005 /* EMC_TCLKSTOP */
					0x00000638 /* EMC_TREFBW */
					0x00000006 /* EMC_QUSE_EXTRA */
					0x00000006 /* EMC_FBIO_CFG6 */
					0x00000000 /* EMC_ODT_WRITE */
					0x00000000 /* EMC_ODT_READ */
					0x00004288 /* EMC_FBIO_CFG5 */
					0x004400a4 /* EMC_CFG_DIG_DLL */
					0x00008000 /* EMC_CFG_DIG_DLL_PERIOD */
					0x00080000 /* EMC_DLL_XFORM_DQS0 */
					0x00080000 /* EMC_DLL_XFORM_DQS1 */
					0x00080000 /* EMC_DLL_XFORM_DQS2 */
					0x00080000 /* EMC_DLL_XFORM_DQS3 */
					0x00080000 /* EMC_DLL_XFORM_DQS4 */
					0x00080000 /* EMC_DLL_XFORM_DQS5 */
					0x00080000 /* EMC_DLL_XFORM_DQS6 */
					0x00080000 /* EMC_DLL_XFORM_DQS7 */
					0x00000000 /* EMC_DLL_XFORM_QUSE0 */
					0x00000000 /* EMC_DLL_XFORM_QUSE1 */
					0x00000000 /* EMC_DLL_XFORM_QUSE2 */
					0x00000000 /* EMC_DLL_XFORM_QUSE3 */
					0x00000000 /* EMC_DLL_XFORM_QUSE4 */
					0x00000000 /* EMC_DLL_XFORM_QUSE5 */
					0x00000000 /* EMC_DLL_XFORM_QUSE6 */
					0x00000000 /* EMC_DLL_XFORM_QUSE7 */
					0x00000000 /* EMC_DLI_TRIM_TXDQS0 */
					0x00000000 /* EMC_DLI_TRIM_TXDQS1 */
					0x00000000 /* EMC_DLI_TRIM_TXDQS2 */
					0x00000000 /* EMC_DLI_TRIM_TXDQS3 */
					0x00000000 /* EMC_DLI_TRIM_TXDQS4 */
					0x00000000 /* EMC_DLI_TRIM_TXDQS5 */
					0x00000000 /* EMC_DLI_TRIM_TXDQS6 */
					0x00000000 /* EMC_DLI_TRIM_TXDQS7 */
					0x00080000 /* EMC_DLL_XFORM_DQ0 */
					0x00080000 /* EMC_DLL_XFORM_DQ1 */
					0x00080000 /* EMC_DLL_XFORM_DQ2 */
					0x00080000 /* EMC_DLL_XFORM_DQ3 */
					0x000002a0 /* EMC_XM2CMDPADCTRL */
					0x0800211c /* EMC_XM2DQSPADCTRL2 */
					0x00000000 /* EMC_XM2DQPADCTRL2 */
					0x77fff884 /* EMC_XM2CLKPADCTRL */
					0x01f1f108 /* EMC_XM2COMPPADCTRL */
					0x05057404 /* EMC_XM2VTTGENPADCTRL */
					0x54000007 /* EMC_XM2VTTGENPADCTRL2 */
					0x08000168 /* EMC_XM2QUSEPADCTRL */
					0x08000000 /* EMC_XM2DQSPADCTRL3 */
					0x00000802 /* EMC_CTT_TERM_CTRL */
					0x00020000 /* EMC_ZCAL_INTERVAL */
					0x00000100 /* EMC_ZCAL_WAIT_CNT */
					0x000c000c /* EMC_MRS_WAIT_CNT */
					0xa0f10000 /* EMC_AUTO_CAL_CONFIG */
					0x00000000 /* EMC_CTT */
					0x00000000 /* EMC_CTT_DURATION */
					0x80000d22 /* EMC_DYN_SELF_REF_CONTROL */
					0x00000006 /* MC_EMEM_ARB_CFG */
					0xc0000025 /* MC_EMEM_ARB_OUTSTANDING_REQ */
					0x00000001 /* MC_EMEM_ARB_TIMING_RCD */
					0x00000001 /* MC_EMEM_ARB_TIMING_RP */
					0x00000005 /* MC_EMEM_ARB_TIMING_RC */
					0x00000002 /* MC_EMEM_ARB_TIMING_RAS */
					0x00000004 /* MC_EMEM_ARB_TIMING_FAW */
					0x00000001 /* MC_EMEM_ARB_TIMING_RRD */
					0x00000003 /* MC_EMEM_ARB_TIMING_RAP2PRE */
					0x00000008 /* MC_EMEM_ARB_TIMING_WAP2PRE */
					0x00000002 /* MC_EMEM_ARB_TIMING_R2R */
					0x00000001 /* MC_EMEM_ARB_TIMING_W2W */
					0x00000002 /* MC_EMEM_ARB_TIMING_R2W */
					0x00000006 /* MC_EMEM_ARB_TIMING_W2R */
					0x06020102 /* MC_EMEM_ARB_DA_TURNS */
					0x000a0505 /* MC_EMEM_ARB_DA_COVERS */
					0x73840a06 /* MC_EMEM_ARB_MISC0 */
					0x001f0000 /* MC_EMEM_ARB_RING1_THROTTLE */
					0xe8000000 /* EMC_FBIO_SPARE */
					0xff00ff00 /* EMC_CFG_RSV */
				>;
			};
			timing-40000000 {
				clock-frequency = <40000000>;

				nvidia,emc-zcal-cnt-long = <0x00000040>;
				nvidia,emc-auto-cal-interval = <0x001fffff>;
				nvidia,emc-mode-reset = <0x80000521>;
				nvidia,emc-mode-1 = <0x80100002>;
				nvidia,emc-mode-2 = <0x80200000>;

				nvidia,emc-configuration = <
					0x00000012 /* EMC_RC */
					0x00000066 /* EMC_RFC */
					0x0000000c /* EMC_RAS */
					0x00000004 /* EMC_RP */
					0x00000003 /* EMC_R2W */
					0x00000008 /* EMC_W2R */
					0x00000002 /* EMC_R2P */
					0x0000000a /* EMC_W2P */
					0x00000004 /* EMC_RD_RCD */
					0x00000004 /* EMC_WR_RCD */
					0x00000002 /* EMC_RRD */
					0x00000001 /* EMC_REXT */
					0x00000000 /* EMC_WEXT */
					0x00000004 /* EMC_WDV */
					0x00000006 /* EMC_QUSE */
					0x00000004 /* EMC_QRST */
					0x0000000a /* EMC_QSAFE */
					0x0000000c /* EMC_RDV */
					0x00000bf0 /* EMC_REFRESH */
					0x00000000 /* EMC_BURST_REFRESH_NUM */
					0x000002fc /* EMC_PRE_REFRESH_REQ_CNT */
					0x00000001 /* EMC_PDEX2WR */
					0x00000008 /* EMC_PDEX2RD */
					0x00000001 /* EMC_PCHG2PDEN */
					0x00000000 /* EMC_ACT2PDEN */
					0x00000008 /* EMC_AR2PDEN */
					0x0000000f /* EMC_RW2PDEN */
					0x0000006c /* EMC_TXSR */
					0x00000200 /* EMC_TXSRDLL */
					0x00000004 /* EMC_TCKE */
					0x00000010 /* EMC_TFAW */
					0x00000000 /* EMC_TRPAB */
					0x00000004 /* EMC_TCLKSTABLE */
					0x00000005 /* EMC_TCLKSTOP */
					0x00000c30 /* EMC_TREFBW */
					0x00000000 /* EMC_QUSE_EXTRA */
					0x00000004 /* EMC_FBIO_CFG6 */
					0x00000000 /* EMC_ODT_WRITE */
					0x00000000 /* EMC_ODT_READ */
					0x00007088 /* EMC_FBIO_CFG5 */
					0x001d0084 /* EMC_CFG_DIG_DLL */
					0x00008000 /* EMC_CFG_DIG_DLL_PERIOD */
					0x0003c000 /* EMC_DLL_XFORM_DQS0 */
					0x0003c000 /* EMC_DLL_XFORM_DQS1 */
					0x0003c000 /* EMC_DLL_XFORM_DQS2 */
					0x0003c000 /* EMC_DLL_XFORM_DQS3 */
					0x0003c000 /* EMC_DLL_XFORM_DQS4 */
					0x0003c000 /* EMC_DLL_XFORM_DQS5 */
					0x0003c000 /* EMC_DLL_XFORM_DQS6 */
					0x000c000 /* EMC_DLL_XFORM_DQS7 */
					0x00000000 /* EMC_DLL_XFORM_QUSE0 */
					0x00000000 /* EMC_DLL_XFORM_QUSE1 */
					0x00000000 /* EMC_DLL_XFORM_QUSE2 */
					0x00000000 /* EMC_DLL_XFORM_QUSE3 */
					0x00000000 /* EMC_DLL_XFORM_QUSE4 */
					0x00000000 /* EMC_DLL_XFORM_QUSE5 */
					0x00000000 /* EMC_DLL_XFORM_QUSE6 */
					0x00000000 /* EMC_DLL_XFORM_QUSE7 */
					0x00000000 /* EMC_DLI_TRIM_TXDQS0 */
					0x00000000 /* EMC_DLI_TRIM_TXDQS1 */
					0x00000000 /* EMC_DLI_TRIM_TXDQS2 */
					0x00000000 /* EMC_DLI_TRIM_TXDQS3 */
					0x00000000 /* EMC_DLI_TRIM_TXDQS4 */
					0x00000000 /* EMC_DLI_TRIM_TXDQS5 */
					0x00000000 /* EMC_DLI_TRIM_TXDQS6 */
					0x00000000 /* EMC_DLI_TRIM_TXDQS7 */
					0x00048000 /* EMC_DLL_XFORM_DQ0 */
					0x00048000 /* EMC_DLL_XFORM_DQ1 */
					0x00048000 /* EMC_DLL_XFORM_DQ2 */
					0x00048000 /* EMC_DLL_XFORM_DQ3 */
					0x000002a0 /* EMC_XM2CMDPADCTRL */
					0x0800013d /* EMC_XM2DQSPADCTRL2 */
					0x00000000 /* EMC_XM2DQPADCTRL2 */
					0x77fff884 /* EMC_XM2CLKPADCTRL */
					0x01f1f508 /* EMC_XM2COMPPADCTRL */
					0x05057404 /* EMC_XM2VTTGENPADCTRL */
					0x54000007 /* EMC_XM2VTTGENPADCTRL2 */
					0x080001e8 /* EMC_XM2QUSEPADCTRL */
					0x08000021 /* EMC_XM2DQSPADCTRL3 */
					0x00000802 /* EMC_CTT_TERM_CTRL */
					0x00020000 /* EMC_ZCAL_INTERVAL */
					0x00000100 /* EMC_ZCAL_WAIT_CNT */
					0x0158000c /* EMC_MRS_WAIT_CNT */
					0xa0f10000 /* EMC_AUTO_CAL_CONFIG */
					0x00000000 /* EMC_CTT */
					0x00000000 /* EMC_CTT_DURATION */
					0x800018c8 /* EMC_DYN_SELF_REF_CONTROL */
					0x0000000c /* MC_EMEM_ARB_CFG */
					0xc0000048 /* MC_EMEM_ARB_OUTSTANDING_REQ */
					0x00000001 /* MC_EMEM_ARB_TIMING_RCD */
					0x00000002 /* MC_EMEM_ARB_TIMING_RP */
					0x00000009 /* MC_EMEM_ARB_TIMING_RC */
					0x00000005 /* MC_EMEM_ARB_TIMING_RAS */
					0x00000007 /* MC_EMEM_ARB_TIMING_FAW */
					0x00000001 /* MC_EMEM_ARB_TIMING_RRD */
					0x00000002 /* MC_EMEM_ARB_TIMING_RAP2PRE */
					0x00000008 /* MC_EMEM_ARB_TIMING_WAP2PRE */
					0x00000002 /* MC_EMEM_ARB_TIMING_R2R */
					0x00000002 /* MC_EMEM_ARB_TIMING_W2W */
					0x00000003 /* MC_EMEM_ARB_TIMING_R2W */
					0x00000006 /* MC_EMEM_ARB_TIMING_W2R */
					0x06030202 /* MC_EMEM_ARB_DA_TURNS */
					0x000d0709 /* MC_EMEM_ARB_DA_COVERS */
					0x7086120a /* MC_EMEM_ARB_MISC0 */
					0x001f0000 /* MC_EMEM_ARB_RING1_THROTTLE */
					0xe8000000 /* EMC_FBIO_SPARE */
					0xff00ff89 /* EMC_CFG_RSV */
				>;
			};
			timing-80000000 {
				clock-frequency = <80000000>;

				nvidia,emc-zcal-cnt-long = <0x00000040>;
				nvidia,emc-auto-cal-interval = <0x001fffff>;
				nvidia,emc-mode-reset = <0x80000d71>;
				nvidia,emc-mode-1 = <0x80100002>;
				nvidia,emc-mode-2 = <0x80200018>;

				nvidia,emc-configuration = <
					0x00000025 /* EMC_RC */
					0x000000ce /* EMC_RFC */
					0x0000001a /* EMC_RAS */
					0x00000009 /* EMC_RP */
					0x00000005 /* EMC_R2W */
					0x0000000d /* EMC_W2R */
					0x00000004 /* EMC_R2P */
					0x00000013 /* EMC_W2P */
					0x00000009 /* EMC_RD_RCD */
					0x00000009 /* EMC_WR_RCD */
					0x00000004 /* EMC_RRD */
					0x00000001 /* EMC_REXT */
					0x00000000 /* EMC_WEXT */
					0x00000007 /* EMC_WDV */
					0x0000000a /* EMC_QUSE */
					0x00000009 /* EMC_QRST */
					0x0000000b /* EMC_QSAFE */
					0x00000011 /* EMC_RDV */
					0x00001820 /* EMC_REFRESH */
					0x00000000 /* EMC_BURST_REFRESH_NUM */
					0x00000608 /* EMC_PRE_REFRESH_REQ_CNT */
					0x00000003 /* EMC_PDEX2WR */
					0x00000012 /* EMC_PDEX2RD */
					0x00000001 /* EMC_PCHG2PDEN */
					0x00000000 /* EMC_ACT2PDEN */
					0x0000000f /* EMC_AR2PDEN */
					0x00000018 /* EMC_RW2PDEN */
					0x000000d8 /* EMC_TXSR */
					0x00000200 /* EMC_TXSRDLL */
					0x00000005 /* EMC_TCKE */
					0x00000020 /* EMC_TFAW */
					0x00000000 /* EMC_TRPAB */
					0x00000007 /* EMC_TCLKSTABLE */
					0x00000008 /* EMC_TCLKSTOP */
					0x00001860 /* EMC_TREFBW */
					0x0000000b /* EMC_QUSE_EXTRA */
					0x00000006 /* EMC_FBIO_CFG6 */
					0x00000000 /* EMC_ODT_WRITE */
					0x00000000 /* EMC_ODT_READ */
					0x00005088 /* EMC_FBIO_CFG5 */
					0xf0070191 /* EMC_CFG_DIG_DLL */
					0x00008000 /* EMC_CFG_DIG_DLL_PERIOD */
					0x0000800a /* EMC_DLL_XFORM_DQS0 */
					0x0000000a /* EMC_DLL_XFORM_DQS1 */
					0x0000000a /* EMC_DLL_XFORM_DQS2 */
					0x0000000a /* EMC_DLL_XFORM_DQS3 */
					0x0000000a /* EMC_DLL_XFORM_DQS4 */
					0x0000000a /* EMC_DLL_XFORM_DQS5 */
					0x0000000a /* EMC_DLL_XFORM_DQS6 */
					0x0000000a /* EMC_DLL_XFORM_DQS7 */
					0x00018000 /* EMC_DLL_XFORM_QUSE0 */
					0x00018000 /* EMC_DLL_XFORM_QUSE1 */
					0x00018000 /* EMC_DLL_XFORM_QUSE2 */
					0x00018000 /* EMC_DLL_XFORM_QUSE3 */
					0x00018000 /* EMC_DLL_XFORM_QUSE4 */
					0x00018000 /* EMC_DLL_XFORM_QUSE5 */
					0x00018000 /* EMC_DLL_XFORM_QUSE6 */
					0x00018000 /* EMC_DLL_XFORM_QUSE7 */
					0x00000000 /* EMC_DLI_TRIM_TXDQS0 */
					0x00000000 /* EMC_DLI_TRIM_TXDQS1 */
					0x00000000 /* EMC_DLI_TRIM_TXDQS2 */
					0x00000000 /* EMC_DLI_TRIM_TXDQS3 */
					0x00000000 /* EMC_DLI_TRIM_TXDQS4 */
					0x00000000 /* EMC_DLI_TRIM_TXDQS5 */
					0x00000000 /* EMC_DLI_TRIM_TXDQS6 */
					0x00000000 /* EMC_DLI_TRIM_TXDQS7 */
					0x0000000a /* EMC_DLL_XFORM_DQ0 */
					0x0000000a /* EMC_DLL_XFORM_DQ1 */
					0x0000000a /* EMC_DLL_XFORM_DQ2 */
					0x0000000a /* EMC_DLL_XFORM_DQ3 */
					0x000002a0 /* EMC_XM2CMDPADCTRL */
					0x0600013d /* EMC_XM2DQSPADCTRL2 */
					0x22220000 /* EMC_XM2DQPADCTRL2 */
					0x77fff884 /* EMC_XM2CLKPADCTRL */
					0x01f1f501 /* EMC_XM2COMPPADCTRL */
					0x07077404 /* EMC_XM2VTTGENPADCTRL */
					0x54000000 /* EMC_XM2VTTGENPADCTRL2 */
					0x080001e8 /* EMC_XM2QUSEPADCTRL */
					0x08000021 /* EMC_XM2DQSPADCTRL3 */
					0x00000802 /* EMC_CTT_TERM_CTRL */
					0x00020000 /* EMC_ZCAL_INTERVAL */
					0x00000100 /* EMC_ZCAL_WAIT_CNT */
					0x00f0000c /* EMC_MRS_WAIT_CNT */
					0xa0f10000 /* EMC_AUTO_CAL_CONFIG */
					0x00000000 /* EMC_CTT */
					0x00000000 /* EMC_CTT_DURATION */
					0x8000308c /* EMC_DYN_SELF_REF_CONTROL */
					0x00000018 /* MC_EMEM_ARB_CFG */
					0xc0000090 /* MC_EMEM_ARB_OUTSTANDING_REQ */
					0x00000004 /* MC_EMEM_ARB_TIMING_RCD */
					0x00000005 /* MC_EMEM_ARB_TIMING_RP */
					0x00000013 /* MC_EMEM_ARB_TIMING_RC */
					0x0000000c /* MC_EMEM_ARB_TIMING_RAS */
					0x0000000f /* MC_EMEM_ARB_TIMING_FAW */
					0x00000002 /* MC_EMEM_ARB_TIMING_RRD */
					0x00000003 /* MC_EMEM_ARB_TIMING_RAP2PRE */
					0x0000000c /* MC_EMEM_ARB_TIMING_WAP2PRE */
					0x00000002 /* MC_EMEM_ARB_TIMING_R2R */
					0x00000002 /* MC_EMEM_ARB_TIMING_W2W */
					0x00000004 /* MC_EMEM_ARB_TIMING_R2W */
					0x00000008 /* MC_EMEM_ARB_TIMING_W2R */
					0x08040202 /* MC_EMEM_ARB_DA_TURNS */
					0x00160d13 /* MC_EMEM_ARB_DA_COVERS */
					0x712c2414 /* MC_EMEM_ARB_MISC0 */
					0x001f0000 /* MC_EMEM_ARB_RING1_THROTTLE */
					0xe8000000 /* EMC_FBIO_SPARE */
					0xff00ff49 /* EMC_CFG_RSV */
				>;
			};
		};
	};
};
